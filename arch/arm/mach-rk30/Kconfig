## arch/arm/mach-rk30/Kconfig
```kconfig
if ARCH_RK30

choice
	prompt "RK30xx Board Type"
	default MACH_RK30_SDK

config MACH_RK30_SDK
	bool "RK30 SDK board"

config MACH_RK3066_SDK
	bool "RK3066 SDK board"

config MACH_RK30_DS1001B
        bool "RK30 DS1001B board"

config MACH_RK30_PHONE_PAD
        bool "RK30 smart phone pad board"
        
config MACH_RK30_PHONE
	bool "RK30 smart phone board"

config MACH_RK30_PHONE_LOQUAT
	bool "RK30 smart phone loquat board"

config MACH_RK30_PHONE_A22
        bool "RK30 smart phone a22 board"

config MACH_PIPO_M3
	bool "Pipo M3 MID device"
	
config MACH_RK30_CUBE_U30GT
        bool "Cube U30GT MID"
	
config MACH_ODYS_GENIO
        bool "Odys Genio MID device"
	
endchoice

endif
```

## drivers/video/rockchip/Kconfig
```kconfig
config FB_ROCKCHIP
        tristate "Frame buffer support for Rockchip "
        depends on FB
        select FB_CFB_FILLRECT
        select FB_CFB_COPYAREA
        select FB_CFB_IMAGEBLIT
        ---help---
          Framebuffer driver for rockchip based platform

config FB_MIRRORING
	bool     "Mirroring support"
	depends on FB_ROCKCHIP

config LCDC_RK30
        tristate "rk30 lcdc support "
        depends on FB_ROCKCHIP
        help
          Driver for rk30 lcdc .There are two lcd controllers on rk30

config LCDC0_RK30
	bool "lcdc0 support"
	depends on LCDC_RK30
	default y
	help 
	   Support rk30 lcdc0 if you say y here

config LCDC1_RK30
        bool "lcdc1 support"
        depends on LCDC_RK30
        default y if HDMI_RK30
        help
           Support rk30 lcdc1 if you say y here

config DUAL_DISP_IN_KERNEL
	bool "implement dual display in kernel"
	depends on FB_ROCKCHIP
	default y if HDMI_RK30
	help
	  select y will implement dual screen display in kernel

config ONE_LCDC_DUAL_OUTPUT_INF
        bool "one lcdc dual output display interface support"
       depends on FB_ROCKCHIP
        default y if ARCH_RK2928
        help
          select y if on platform like rk2928 which have one lcdc but two output interface

config THREE_FB_BUFFER
	bool "Three fb buffer support"
	depends on FB_ROCKCHIP
	default y
	help
	   select y if android support three buffer,like Jelly Bean
source "drivers/video/rockchip/hdmi/Kconfig"
source "drivers/video/rockchip/rga/Kconfig"
```
